## arch/arm/cpu/armv7/omap3/Kconfig
```kconfig
if OMAP34XX

choice
	prompt "OMAP3 board select"
	optional

config TARGET_AM3517_EVM
	bool "AM3517 EVM"
	select SUPPORT_SPL

config TARGET_MT_VENTOUX
	bool "TeeJet Mt.Ventoux"
	select SUPPORT_SPL

config TARGET_OMAP3_BEAGLE
	bool "TI OMAP3 BeagleBoard"
	select SUPPORT_SPL
	select DM
	select DM_SERIAL
	select DM_GPIO

config TARGET_CM_T35
	bool "CompuLab CM-T3530 and CM-T3730 boards"
	select SUPPORT_SPL

config TARGET_CM_T3517
	bool "CompuLab CM-T3517 boards"

config TARGET_DEVKIT8000
	bool "TimLL OMAP3 Devkit8000"
	select SUPPORT_SPL
	select DM
	select DM_SERIAL
	select DM_GPIO

config TARGET_OMAP3_EVM
	bool "TI OMAP3 EVM"
	select SUPPORT_SPL

config TARGET_OMAP3_EVM_QUICK_MMC
	bool "TI OMAP3 EVM Quick MMC"
	select SUPPORT_SPL

config TARGET_OMAP3_EVM_QUICK_NAND
	bool "TI OMAP3 EVM Quick NAND"
	select SUPPORT_SPL

config TARGET_OMAP3_IGEP00X0
	bool "IGEP"
	select SUPPORT_SPL
	select DM
	select DM_SERIAL
	select DM_GPIO

config TARGET_OMAP3_OVERO
	bool "OMAP35xx Gumstix Overo"
	select SUPPORT_SPL
	select DM
	select DM_SERIAL
	select DM_GPIO

config TARGET_OMAP3_ZOOM1
	bool "TI Zoom1"
	select DM
	select DM_SERIAL
	select DM_GPIO

config TARGET_AM3517_CRANE
	bool "am3517_crane"
	select SUPPORT_SPL

config TARGET_OMAP3_PANDORA
	bool "OMAP3 Pandora"

config TARGET_ECO5PK
	bool "ECO5PK"
	select SUPPORT_SPL

config TARGET_TRICORDER
	bool "Tricorder"
	select SUPPORT_SPL

config TARGET_MCX
	bool "MCX"
	select SUPPORT_SPL

config TARGET_OMAP3_LOGIC
	bool "OMAP3 Logic"
	select DM
	select DM_SERIAL
	select DM_GPIO
	select SUPPORT_SPL

config TARGET_NOKIA_RX51
	bool "Nokia RX51"

config TARGET_TAO3530
	bool "TAO3530"
	select SUPPORT_SPL

config TARGET_TWISTER
	bool "Twister"
	select SUPPORT_SPL

config TARGET_OMAP3_CAIRO
	bool "QUIPOS CAIRO"
	select SUPPORT_SPL
	select DM
	select DM_SERIAL
	select DM_GPIO

config TARGET_SNIPER
	bool "LG Optimus Black"
	select SUPPORT_SPL
	select DM
	select DM_SERIAL
	select DM_GPIO

endchoice

config SYS_SOC
	default "omap3"

source "board/ti/evm/Kconfig"

endif
```

## arch/arm/cpu/armv7/omap4/Kconfig
```kconfig
if OMAP44XX

choice
	prompt "OMAP4 board select"
	optional

config TARGET_DUOVERO
	bool "OMAP4430 Gumstix Duovero"

config TARGET_OMAP4_PANDA
	bool "TI OMAP4 PandaBoard"

config TARGET_OMAP4_SDP4430
	bool "TI OMAP4 SDP4430"

config TARGET_KC1
	bool "Amazon Kindle Fire (first generation)"

endchoice

config SYS_SOC
	default "omap4"


endif
```

## board/ti/dra7xx/Kconfig
```kconfig
if TARGET_DRA7XX_EVM

config SYS_BOARD
	default "dra7xx"

config SYS_VENDOR
	default "ti"

config SYS_CONFIG_NAME
	default "dra7xx_evm"

config CONS_INDEX
	int "UART used for console"
	range 1 6
	default 1
	help
	  The DRA7xx (and AM57x) SoC has a total of 6 UARTs available to it.
	  Depending on your specific board you may want something other than UART1
	  here.

config TARGET_DRA7XX_EVM_VISION
	bool "Vision daughter card support"

menu "Early Boot/Late Attach"

config LATE_ATTACH
	bool "Enable late attach"
	default n
	help
	  Enable this flag if you want to boot remotecores(M4/DSP) from
	  SPL. The specific cores loaded is controlled by the array
	  cores_to_boot[] in spl.c. Currently only ELF format
	  binaries are supported for loading.


config LATE_ATTACH_GPT_PART
	bool "Enable loading remotecore binaries from GPT partitions"
	depends on LATE_ATTACH
	default n
	help
	  In case of Linux boot, the binaries are read from the FAT parition of
	  the eMMC or SD card based on the boot media. Android uses GPT partitions
	  on eMMC for storing the binaries. Enable this option to read remotecore
	  binaries from GPT partitions.


config LATE_ATTACH_DMA_POOL
	bool "Enable using a DMA pool instead of a CMA pool"
	depends on LATE_ATTACH
	default n
	help
	  It may be desireable to define the reserved memory as no-map rather
	  than as reusable in order to prevent access by other kernel modules to
	  the memory before the remoteproc driver has a chance to allocate from
	  the CMA pool and reclaim the memory. In this way the memory is reserved
	  explicitly for the remote core and kernel cannot allocate from it even
	  when not in use by remoteproc.

endmenu

source "board/ti/common/Kconfig"

endif
```

## drivers/Kconfig
```kconfig
menu "Device Drivers"

source "drivers/core/Kconfig"

# types of drivers sorted in alphabetical order

source "drivers/block/Kconfig"

source "drivers/clk/Kconfig"

source "drivers/cpu/Kconfig"

source "drivers/dfu/Kconfig"

source "drivers/gpio/Kconfig"

source "drivers/i2c/Kconfig"

source "drivers/input/Kconfig"

source "drivers/memory/Kconfig"

source "drivers/mmc/Kconfig"

source "drivers/pinctrl/Kconfig"

source "drivers/power/Kconfig"

source "drivers/ram/Kconfig"

source "drivers/remoteproc/Kconfig"

source "drivers/rtc/Kconfig"

source "drivers/serial/Kconfig"

source "drivers/spi/Kconfig"

source "drivers/timer/Kconfig"

source "drivers/usb/Kconfig"


config PHYS_TO_BUS
	bool "Custom physical to bus address mapping"
	help
	  Some SoCs use a different address map for CPU physical addresses and
	  peripheral DMA master accesses. If yours does, select this option in
	  your platform's Kconfig, and implement the appropriate mapping
	  functions in your platform's support code.

endmenu
```

## fs/Kconfig
```kconfig
#
# File system configuration
#

menu "File systems"

source "fs/ext4/Kconfig"

endmenu
```
